// This file was generated from a template. Edit it to match your keyboard.
// See https://zmk.dev/docs/development/hardware-integration/new-shield for more
// instructions.

#include "kimiko_rev2.dtsi"

&default_transform {
    // Set this to the number of columns on the left side.
    col-offset = <8>;
};

&kscan {
    // Replace these comments with the GPIO pins in the matrix for the right side.
    // See https://zmk.dev/docs/development/hardware-integration/new-shield#shield-overlays
    col-gpios
        = <&pro_micro 10 GPIO_ACTIVE_HIGH> // B6 (COL5)
        , <&pro_micro 16 GPIO_ACTIVE_HIGH> // B2 (COL4)
        , <&pro_micro 14 GPIO_ACTIVE_HIGH> // B3 (COL3)
        , <&pro_micro 15 GPIO_ACTIVE_HIGH> // B1 (COL2)
        , <&pro_micro 18 GPIO_ACTIVE_HIGH> // F6 (COL1)
        , <&pro_micro 19 GPIO_ACTIVE_HIGH> // F7 (COL0)
        ;
};
