## boards/shields/kimiko_rev2/Kconfig.defconfig
```kconfig
if SHIELD_KIMIKO_REV2_LEFT

config ZMK_KEYBOARD_NAME
    default "kimiko_rev2"

config ZMK_SPLIT_ROLE_CENTRAL
    default y

endif # SHIELD_KIMIKO_REV2_LEFT

if SHIELD_KIMIKO_REV2_LEFT || SHIELD_KIMIKO_REV2_RIGHT

config ZMK_SPLIT
    default y

endif # SHIELD_KIMIKO_REV2_LEFT || SHIELD_KIMIKO_REV2_RIGHT
```

## boards/shields/kimiko_rev2/Kconfig.shield
```kconfig
config SHIELD_KIMIKO_REV2_LEFT
    def_bool $(shields_list_contains,kimiko_rev2_left)

config SHIELD_KIMIKO_REV2_RIGHT
    def_bool $(shields_list_contains,kimiko_rev2_right)
```

## config/west.yml
```yaml
manifest:
  defaults:
    revision: v0.3
  remotes:
    - name: zmkfirmware
      url-base: https://github.com/zmkfirmware
    # Additional modules containing boards/shields/custom code can be listed here as well
    # See https://docs.zephyrproject.org/3.2.0/develop/west/manifest.html#projects
  projects:
    - name: zmk
      remote: zmkfirmware
      import: app/west.yml
    - name: kimiko-rev2-shield-module
      url: https://github.com/mayms/kimiko-rev2-shield-module
      revision: main
      path: modules/kimiko-rev2-shield-module
  self:
    path: config
```
